## CMakeLists.txt
```
# SPDX-License-Identifier: Apache-2.0

cmake_minimum_required(VERSION 3.13.1)
include($ENV{ZEPHYR_BASE}/cmake/app/boilerplate.cmake NO_POLICY_SCOPE)
project(zephyr_usb_test)

FILE(GLOB app_sources src/*.c)
target_sources(app PRIVATE 
    src/main.c
    src/USB/usb_cdc_acm.c
    src/USB/usb_thread.c)
    
zephyr_include_directories(${APPLICATION_SOURCE_DIR}/src)
zephyr_library_include_directories($ENV{ZEPHYR_BASE}/samples/testing/zephyr_usb_test)
```

## Kconfig
```
# Copyright (c) 2019 Nordic Semiconductor ASA
# SPDX-License-Identifier: Apache-2.0

config USB_DEVICE_PID
	default 0x0010

source "Kconfig.zephyr"
```

## sample.yaml
```
sample:
  name: Bluetooth Central
tests:
  sample.cwd_development.central:
    harness: bluetooth
    platform_whitelist: qemu_cortex_m3 qemu_x86
    tags: bluetooth
  sample.usb.cdc-acm:
    depends_on: usb_device gpio
    tags: usb
    harness: console
    harness_config:
      type: one_line
      regex:
        - "Wait for DTR"
  sample.usb.cdc-acm.comp:
    depends_on: usb_device gpio
    tags: usb
    extra_args: "-DOVERLAY_CONFIG=overlay-composite-cdc-msc.conf"
    harness: console
    harness_config:
      type: one_line
      regex:
        - "Wait for DTR"
```

## prj.conf
```kconfig
######
# UART
######
CONFIG_STDOUT_CONSOLE=y
CONFIG_SERIAL=y
CONFIG_UART_INTERRUPT_DRIVEN=y
CONFIG_UART_LINE_CTRL=y
CONFIG_SIZE_OPTIMIZATIONS=y

######
# Misc
######
CONFIG_RING_BUFFER=y
CONFIG_NEWLIB_LIBC=y
CONFIG_POSIX_API=y

######
# USB
######
CONFIG_USB=y
CONFIG_USB_DEVICE_STACK=y
CONFIG_USB_DEVICE_PRODUCT="USB Test"
CONFIG_USB_DEVICE_VID=0xabcd
CONFIG_USB_CDC_ACM=y
CONFIG_USB_CDC_ACM_DEVICE_COUNT=1
CONFIG_USB_CDC_ACM_RINGBUF_SIZE=1024
# CONFIG_USB_DEVICE_LOG_LEVEL_ERR=y
```

## src/main.c
```c
#include <zephyr.h>
#include <sys/byteorder.h>

#include "USB/usb_cdc_acm.h"
#include "USB/usb_thread.h"
#include "constants.h"

K_MSGQ_DEFINE(data_rx_msgq, sizeof(signal_data_buffer), 5, 1);

void
main(void) {

    /**
     * Start Threads.
     */
    start_usb_thread();
}
```

## src/constants.h
```c
typedef struct {
	uint8_t packet_type;
	uint8_t packet_data[30];
	uint16_t packet_len;
} signal_data_buffer;

extern struct ring_buf ble_data_ringbuf;
extern struct k_msgq data_rx_msgq;
```
